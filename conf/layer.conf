## conf/layer.conf
```bitbake
BBPATH .= ":${LAYERDIR}"

BBFILES += "${LAYERDIR}/recipes*/*/*.bb \
            ${LAYERDIR}/recipes*/*/*.bbappend"

BBFILE_COLLECTIONS += "meta-nxview"
BBFILE_PATTERN_meta-nxview := "^${LAYERDIR}/"
BBFILE_PRIORITY_meta-nxview = "97"
LAYERVERSION_meta-nxview = "1"
LAYERSERIES_COMPAT_meta-nxview = "dunfell"

include conf/machine/colibri-imx6ull-extra.conf
```
